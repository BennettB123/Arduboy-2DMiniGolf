#pragma once

#include "FX/ArduboyFX.h"
#include <Arduboy2.h>

constexpr uint8_t CreditsSpriteWidth = 80;
constexpr uint8_t CreditsSpriteHeight = 19;

constexpr uint8_t CreditsSprite[] PROGMEM{
    // Frame 0
    0x7F, 0xFF, 0xC3, 0xDB, 0xFB, 0xFA, 0x00, 0xFE, 0xFF, 0x37, 0x33, 0xFF,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 0x00,
    0xF8, 0xF8, 0x58, 0xD8, 0xF8, 0xB0, 0x00, 0xF8, 0xF8, 0xD8, 0xD8, 0xD8,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 0x00,
    0x07, 0x07, 0x06, 0x06, 0x07, 0x03, 0x00, 0x03, 0x07, 0x06, 0x06, 0x06,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 0x00, 0x00};

void PlayCreditsAnimation(Arduboy2Base arduboy)
{
    int16_t x = -CreditsSpriteWidth;
    int16_t y = 24;

    auto displayCreditsSprite = [&]()
    {
        while (!arduboy.nextFrame());

        arduboy.pollButtons();
        arduboy.clear();
        arduboy.drawBitmap(x, y, CreditsSprite, CreditsSpriteWidth, CreditsSpriteHeight);
        FX::display();
    };

    // move right to center of screen
    while (x < 22)
    {
        if (arduboy.justPressed(A_BUTTON) | arduboy.justPressed(B_BUTTON))
            return;
            
        displayCreditsSprite();
        x += 4;
    }

    // hold for a few frames
    for (uint8_t i = 0; i < 80; i++){
        if (arduboy.justPressed(A_BUTTON) || arduboy.justPressed(B_BUTTON))
            return;

        displayCreditsSprite();
    }

    // move off screen
    while (x < WIDTH + 60)
    {
        if (arduboy.justPressed(A_BUTTON) | arduboy.justPressed(B_BUTTON))
            return;
            
        displayCreditsSprite();
        x += 4;
    }
}